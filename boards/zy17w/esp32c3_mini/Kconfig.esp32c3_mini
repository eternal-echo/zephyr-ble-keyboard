## boards/zy17w/esp32c3_mini/Kconfig.esp32c3_mini
```kconfig
# Copyright (c) 2024 Arrel Neumiller
# SPDX-License-Identifier: Apache-2.0

config BOARD_ESP32C3_MINI
	select SOC_ESP32C3_FH4
```

## boards/zy17w/esp32c3_mini/Kconfig.esp32c3_mini_uart
```kconfig
# Copyright (c) 2025 Arrel Neumiller
# SPDX-License-Identifier: Apache-2.0

config BOARD_ESP32C3_MINI_UART
	bool "ESP32-C3-MINI (CH340 UART)"
	select SOC_ESP32C3_FH4
```

## boards/zy17w/esp32c3_mini/Kconfig.esp32c3_mini_usb
```kconfig
# Copyright (c) 2025 Arrel Neumiller
# SPDX-License-Identifier: Apache-2.0

config BOARD_ESP32C3_MINI_USB
	bool "ESP32-C3-MINI (USB)"
	select SOC_ESP32C3_FH4
```

## boards/zy17w/esp32c3_mini/board.yml
```yaml
# Copyright (c) 2024 Arrel Neumiller
# SPDX-License-Identifier: Apache-2.0

boards:
- name: esp32c3_mini_uart
  full_name: ESP32-C3-MINI (CH340 UART)
  vendor: zy17w
  socs:
  - name: esp32c3
- name: esp32c3_mini_usb
  full_name: ESP32-C3-MINI (USB)
  vendor: zy17w
  socs:
  - name: esp32c3
```

## modules/Kconfig
```kconfig
menuconfig KEYBOARD_COMMON
    bool "Keyboard common modules"
    help
      Common modules for ESP32C3 keyboard projects.

if KEYBOARD_COMMON

config KEYBOARD_COMMON_KEY_INPUT
    bool "Enable Key Input Module (matrix scanning + debounce)"
    default y
    help
      Matrix scanning + debounce with event callback.
      Shared between led_control and bluetooth_keyboard apps.

config KEYBOARD_COMMON_KEY_INPUT_POLL
    bool "Polling mode (scan thread)"
    depends on KEYBOARD_COMMON_KEY_INPUT
    default y
    help
      Use a polling thread to scan the matrix periodically.
      Disable this when switching to interrupt-driven mode.

config KEYBOARD_COMMON_LED_CONTROL
	bool "Enable LED Control Module (brightness + RGB update)"
	default n
	select LED_STRIP
	select REGULATOR
	help
	  LED brightness control + RGB strip update (e.g. WS2812B).
	  Used by led_control app for brightness up/down via matrix keys.

config KEYBOARD_COMMON_LED_CONTROL_POWER_GATE
    bool "LED strip power gate via regulator"
    depends on KEYBOARD_COMMON_LED_CONTROL
    default y
    help
      Enable a regulator-fixed node (led-pwr-ctrl) to cut LED strip power
      during deep sleep.  Boards without this MOSFET gate can disable
      this option — led_power_enable() becomes a no-op.

endif # KEYBOARD_COMMON
```
